## base_external/Config.in
```kconfig
source "$BR2_EXTERNAL_assignment8_BASE_PATH/package/aesd-assignments/Config.in"
source "$BR2_EXTERNAL_assignment8_BASE_PATH/package/aesdchar/Config.in"
```

## base_external/package/aesdchar/Config.in
```kconfig
config BR2_PACKAGE_AESDCHAR
	bool "aesdchar"
	depends on BR2_LINUX_KERNEL
	help
	  AESD character driver for assignment 8.
	  Provides /dev/aesdchar device for socket communication.
```
